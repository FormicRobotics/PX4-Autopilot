## src/drivers/formic_strobe_capture/Kconfig
```kconfig
menuconfig DRIVERS_FORMIC_STROBE_CAPTURE
	bool "formic_strobe_capture"
	default n
	---help---
		Timestamps the tracker camera strobe on its own capture pin
		(output function Formic_Tracker_Strobe) and publishes each edge
		as tracker_strobe, apart from camera_capture and camera_trigger.
```

## src/modules/camera_timesync/Kconfig
```kconfig
menuconfig MODULES_CAMERA_TIMESYNC
	bool "camera_timesync"
	default n
	depends on DRIVERS_CAMERA_CAPTURE || DRIVERS_CAMERA_TRIGGER || DRIVERS_FORMIC_STROBE_CAPTURE
	---help---
		Strobe-based clock sync: matches companion camera frame stamps
		(camera_frame_stamp) with the strobe edges CAMTS_SRC selects
		(tracker_strobe or camera_trigger) and publishes the measured
		clock offset as camera_timesync_status.
```

## src/modules/formic_imu_batch/Kconfig
```kconfig
menuconfig MODULES_FORMIC_IMU_BATCH
	bool "formic imu batch"
	default n
	---help---
		Every FIFO sample of the IMU EKF2 flies on, packed in batches for the Jetson.
```

## src/modules/formic_vio_est/Kconfig
```kconfig
menuconfig MODULES_FORMIC_VIO_EST
	bool "formic vio est"
	default n
	---help---
		Estimator instance 1: the VIO carried to now on the IMU.
```
